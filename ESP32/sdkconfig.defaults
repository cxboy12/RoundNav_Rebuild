## ESP32/sdkconfig.defaults
```kconfig
CONFIG_IDF_TARGET="esp32s3"
CONFIG_ESPTOOLPY_FLASHSIZE_16MB=y
CONFIG_ESPTOOLPY_FLASHMODE_QIO=y
CONFIG_ESPTOOLPY_FLASHFREQ_80M=y
CONFIG_SPIRAM=y
CONFIG_SPIRAM_MODE_OCT=y
CONFIG_SPIRAM_SPEED_80M=y
CONFIG_BT_ENABLED=y
CONFIG_BTDM_CTRL_MODE_BLE_ONLY=y
CONFIG_BTDM_CTRL_MODE_BR_EDR_ONLY=n
CONFIG_BTDM_CTRL_MODE_BTDM=n
CONFIG_BT_BLUEDROID_ENABLED=n
CONFIG_BT_NIMBLE_ENABLED=y
CONFIG_BT_NIMBLE_GATT_SERVER=y
CONFIG_BT_NIMBLE_ROLE_PERIPHERAL=y
CONFIG_BT_NIMBLE_MAX_CONNECTIONS=1
CONFIG_BT_NIMBLE_ATT_PREFERRED_MTU=128
CONFIG_BT_NIMBLE_SVC_GAP_DEVICE_NAME="RoundNav"
CONFIG_PARTITION_TABLE_CUSTOM=y
CONFIG_PARTITION_TABLE_CUSTOM_FILENAME="partitions.csv"
CONFIG_BT_NIMBLE_GAP_SERVICE=y
```

## esp32-direct/main/Kconfig.projbuild
```kconfig
menu "RoundNav Direct 圆屏接收端"

    config DIPLAY_WIFI_SSID
        string "要连接的 Wi-Fi 名称（留空则自建热点）"
        default ""

    config DIPLAY_WIFI_PASSWORD
        string "Wi-Fi 密码"
        default ""

    config DIPLAY_AP_SSID
        string "自建热点名称（留空自动生成 RoundNav-XXXX）"
        default ""

    config DIPLAY_AP_PASSWORD
        string "自建热点密码（至少 8 位，留空为开放热点）"
        default ""

    config DIPLAY_AP_CHANNEL
        int "自建热点信道"
        range 1 13
        default 6

    config DIPLAY_TCP_PORT
        int "推流 TCP 端口"
        default 7000

    config DIPLAY_DISCOVERY_PORT
        int "局域网发现 UDP 广播端口"
        default 7001

    config DIPLAY_MAX_JPEG_KB
        int "单帧 JPEG 上限 (KB)"
        range 32 1024
        default 256

    config DIPLAY_RGB565_BIG_ENDIAN
        bool "像素按 RGB565 大端发送（开机测试图颜色不对时取消勾选）"
        default y

    config DIPLAY_BRIGHTNESS
        int "屏幕亮度 (%)"
        range 1 100
        default 80

    config DIPLAY_BOOT_PATTERN
        bool "开机显示色点和外圈，用于诊断面板"
        default n

endmenu
```

## esp32-direct/sdkconfig.defaults
```kconfig
CONFIG_IDF_TARGET="esp32s3"

# 板子：Waveshare ESP32-S3-Touch-AMOLED-1.75，16 MB Flash，8 MB Octal PSRAM
CONFIG_ESPTOOLPY_FLASHSIZE_16MB=y
CONFIG_ESPTOOLPY_FLASHMODE_QIO=y
CONFIG_ESPTOOLPY_FLASHFREQ_80M=y
CONFIG_SPIRAM=y
CONFIG_SPIRAM_MODE_OCT=y
CONFIG_SPIRAM_SPEED_80M=y
CONFIG_SPIRAM_TRY_ALLOCATE_WIFI_LWIP=y
CONFIG_PARTITION_TABLE_CUSTOM=y
CONFIG_PARTITION_TABLE_CUSTOM_FILENAME="partitions.csv"

# 性能
CONFIG_ESP_DEFAULT_CPU_FREQ_MHZ_240=y
CONFIG_COMPILER_OPTIMIZATION_PERF=y
CONFIG_FREERTOS_HZ=1000

# Wi-Fi 吞吐：加大收包缓冲和块确认窗口
CONFIG_ESP_WIFI_STATIC_RX_BUFFER_NUM=16
CONFIG_ESP_WIFI_DYNAMIC_RX_BUFFER_NUM=64
CONFIG_ESP_WIFI_DYNAMIC_TX_BUFFER_NUM=64
CONFIG_ESP_WIFI_AMPDU_RX_ENABLED=y
CONFIG_ESP_WIFI_RX_BA_WIN=32
CONFIG_ESP_WIFI_IRAM_OPT=y
CONFIG_ESP_WIFI_RX_IRAM_OPT=y

# TCP 接收窗口
CONFIG_LWIP_TCP_WND_DEFAULT=65534
CONFIG_LWIP_TCP_RECVMBOX_SIZE=64
CONFIG_LWIP_TCPIP_RECVMBOX_SIZE=64
CONFIG_LWIP_IRAM_OPTIMIZATION=y

# 不需要蓝牙
CONFIG_BT_ENABLED=n
```
